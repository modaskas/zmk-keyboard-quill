## boards/shields/quill/Kconfig.defconfig
```kconfig
if SHIELD_QUILL

# Name must be less than 16 characters long!
config ZMK_KEYBOARD_NAME
    default "Quill"

endif
```

## boards/shields/quill/Kconfig.shield
```kconfig
# No whitespace after the comma or in your keyboard name!
config SHIELD_QUILL
    def_bool $(shields_list_contains,quill)
```
